## CMakeLists.txt
```
cmake_minimum_required(VERSION 3.13.1)
find_package(Zephyr REQUIRED HINTS $ENV{ZEPHYR_BASE})
project(osapi)

set(APP_SOURCES "")

if(CONFIG_OSAPI_WITH_CUNIT)
    target_include_directories(app PRIVATE "cunit/Headers")

    file(GLOB_RECURSE CUNIT_SOURCES "cunit/Sources/*.c")
    list(APPEND APP_SOURCES ${CUNIT_SOURCES})

    file(GLOB_RECURSE CUNIT_TESTS "src/cunit_tests/*.cpp")
    list(APPEND APP_SOURCES ${CUNIT_TESTS})

    execute_process(COMMAND git apply cunit_patch.patch
                    RESULT_VARIABLE GIT_APPLY_RESULT
                    OUTPUT_QUIET
                    ERROR_QUIET)
    if(NOT "${GIT_APPLY_RESULT}" EQUAL "0")
        message(WARNING "Failed to apply the git patch.")
    endif()
else()
    list(APPEND APP_SOURCES "src/main.cpp")
endif()

list(APPEND APP_SOURCES "src/osapi/zephyr/osapi_zephyr.cpp")
target_include_directories(app PRIVATE "src/osapi")

target_sources(app PRIVATE ${APP_SOURCES})
```

## Kconfig
```
menu "osapi-app"

config OSAPI_WITH_CUNIT
	bool "Test OSAPI using CUnit"
	default n

config OSAPI_USE_ZEPHYR
        bool "Use ZephyrRTOS in OSAPI"
	default y
endmenu

source "Kconfig.zephyr"
```

## west.yml
```
manifest:
  remotes:
  - name: zephyrproject-rtos
    url-base: https://github.com/zephyrproject-rtos
  projects:
  - name: zephyr
    path: zephyr
    remote: zephyrproject-rtos
    revision: v3.4.99-ncs1
    import: true
```

## prj.conf
```kconfig
CONFIG_CPP=y
CONFIG_DYNAMIC_THREAD=y
CONFIG_DYNAMIC_THREAD_ALLOC=y
CONFIG_MAIN_STACK_SIZE=16384
CONFIG_HEAP_MEM_POOL_SIZE=16384
CONFIG_INIT_STACKS=y
CONFIG_THREAD_STACK_INFO=y
CONFIG_THREAD_NAME=y

CONFIG_OSAPI_USE_ZEPHYR=y
CONFIG_OSAPI_WITH_CUNIT=y
# for CUnit's setjmp
CONFIG_NEWLIB_LIBC=y
```

## src/main.cpp
```c
#include <zephyr/kernel.h>

#define SLEEP_TIME_MS 250

int main(void)
{
	while (1) {
		printk("Hello, World!\n");
		k_msleep(SLEEP_TIME_MS);
	}

	return 0;
}
```
